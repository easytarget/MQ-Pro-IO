# 0 "sunxi-d1-t113.dtsi"
# 0 "<built-in>"
# 0 "<command-line>"
# 1 "sunxi-d1-t113.dtsi"



/ {
 soc {
  dsp_wdt: watchdog@1700400 {
   compatible = "allwinner,sun20i-d1-wdt";
   reg = <0x1700400 0x20>;
   interrupts = <SOC_PERIPHERAL_IRQ(122) IRQ_TYPE_LEVEL_HIGH>;
   clocks = <&dcxo>, <&rtc CLK_OSC32K>;
   clock-names = "hosc", "losc";
   status = "reserved";
  };
 };
};
