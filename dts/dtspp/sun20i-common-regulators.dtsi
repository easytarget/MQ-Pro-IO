# 0 "sun20i-common-regulators.dtsi"
# 0 "<built-in>"
# 0 "<command-line>"
# 1 "sun20i-common-regulators.dtsi"



/ {
 reg_vcc: vcc {
  compatible = "regulator-fixed";
  regulator-name = "vcc";
  regulator-min-microvolt = <5000000>;
  regulator-max-microvolt = <5000000>;
 };

 reg_vcc_3v3: vcc-3v3 {
  compatible = "regulator-fixed";
  regulator-name = "vcc-3v3";
  regulator-min-microvolt = <3300000>;
  regulator-max-microvolt = <3300000>;
  vin-supply = <&reg_vcc>;
 };
};

&pio {
 vcc-pb-supply = <&reg_vcc_3v3>;
 vcc-pc-supply = <&reg_vcc_3v3>;
 vcc-pd-supply = <&reg_vcc_3v3>;
 vcc-pe-supply = <&reg_vcc_3v3>;
 vcc-pf-supply = <&reg_vcc_3v3>;
 vcc-pg-supply = <&reg_vcc_3v3>;
};
